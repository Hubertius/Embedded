# file: Zadanie_2.ioc
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Mcu.Family=STM32L4
Mcu.Name=STM32L496Z(E-G)Tx
Mcu.Package=LQFP144
NVIC.PriorityGroup=NVIC_PRIORITYGROUP_4
PA13\ (JTMS/SWDIO).Mode=Serial_Wire
PA13\ (JTMS/SWDIO).Signal=SYS_JTMS-SWDIO
PA14\ (JTCK/SWCLK).Mode=Serial_Wire
PA14\ (JTCK/SWCLK).Signal=SYS_JTCK-SWCLK
ProjectManager.HeapSize=0x200
ProjectManager.StackSize=0x400
ProjectManager.TargetToolchain=STM32CubeIDE
RCC.HSE_VALUE=8000000
RCC.HSI48_VALUE=48000000
RCC.HSI_VALUE=16000000
RCC.LSE_VALUE=32768
RCC.MSI_VALUE=4000000
RCC.VCOOutputFreq_Value=32000000
board=custom

// file: Core/Src/main.c
/* USER CODE BEGIN Header */
/**
  ******************************************************************************
  * @file           : main.c
  * @brief          : Main program body
  ******************************************************************************
  * @attention
  *
  * Copyright (c) 2021 STMicroelectronics.
  * All rights reserved.
  *
  * This software is licensed under terms that can be found in the LICENSE file
  * in the root directory of this software component.
  * If no LICENSE file comes with this software, it is provided AS-IS.
  *
  ******************************************************************************
  */
/* USER CODE END Header */
#include "main.h"

/* USER CODE BEGIN PV */
GPIO_InitTypeDef LED_C_init;
GPIO_InitTypeDef LED_D_init;
GPIO_InitTypeDef LED_E_init;

int values_for_LEDS_C[] = {
		GPIO_PIN_6, // LED 0
		GPIO_PIN_7, // LED 1
		GPIO_PIN_8, // LED 2
		GPIO_PIN_9  // LED 3
};

int values_for_LEDS_E[] = {
		GPIO_PIN_4, // LED 4
		GPIO_PIN_5, // LED 6
		GPIO_PIN_6  // LED 7
};
/* USER CODE END PV */

void SystemClock_Config(void);
static void MX_GPIO_Init(void);
/* USER CODE BEGIN PFP */
void ledInit();
void lightLED(int numberOfLED);
void resetLED(int numberOfLED);
void lightAllLEDS();
void resetAllLEDS();
/* USER CODE END PFP */

int main(void)
{
  /* USER CODE BEGIN 1 */
  __HAL_RCC_GPIOD_CLK_ENABLE();
  __HAL_RCC_GPIOC_CLK_ENABLE();
  __HAL_RCC_GPIOE_CLK_ENABLE();
  /* USER CODE END 1 */

  /* MCU Configuration--------------------------------------------------------*/

  /* Reset of all peripherals, Initializes the Flash interface and the Systick. */
  HAL_Init();

  /* USER CODE BEGIN Init */
  ledInit();
  /* USER CODE END Init */

  /* Configure the system clock */
  SystemClock_Config();

  /* Initialize all configured peripherals */
  MX_GPIO_Init();

  /* Infinite loop */
  while (1)
  {
	  lightAllLEDS();
	  resetAllLEDS();
	  HAL_Delay(2000);
  }
}

void SystemClock_Config(void)
{
  RCC_OscInitTypeDef RCC_OscInitStruct = {0};
  RCC_ClkInitTypeDef RCC_ClkInitStruct = {0};

  /** Configure the main internal regulator output voltage
  */
  if (HAL_PWREx_ControlVoltageScaling(PWR_REGULATOR_VOLTAGE_SCALE1) != HAL_OK)
  {
    Error_Handler();
  }
  /** Initializes the RCC Oscillators according to the specified parameters
  * in the RCC_OscInitTypeDef structure.
  */
  RCC_OscInitStruct.OscillatorType = RCC_OSCILLATORTYPE_MSI;
  RCC_OscInitStruct.MSIState = RCC_MSI_ON;
  RCC_OscInitStruct.MSICalibrationValue = 0;
  RCC_OscInitStruct.MSIClockRange = RCC_MSIRANGE_6;
  RCC_OscInitStruct.PLL.PLLState = RCC_PLL_NONE;
  if (HAL_RCC_OscConfig(&RCC_OscInitStruct) != HAL_OK)
  {
    Error_Handler();
  }
  /** Initializes the CPU, AHB and APB buses clocks
  */
  RCC_ClkInitStruct.ClockType = RCC_CLOCKTYPE_HCLK|RCC_CLOCKTYPE_SYSCLK
                              |RCC_CLOCKTYPE_PCLK1|RCC_CLOCKTYPE_PCLK2;
  RCC_ClkInitStruct.SYSCLKSource = RCC_SYSCLKSOURCE_MSI;
  RCC_ClkInitStruct.AHBCLKDivider = RCC_SYSCLK_DIV1;
  RCC_ClkInitStruct.APB1CLKDivider = RCC_HCLK_DIV1;
  RCC_ClkInitStruct.APB2CLKDivider = RCC_HCLK_DIV1;

  if (HAL_RCC_ClockConfig(&RCC_ClkInitStruct, FLASH_LATENCY_0) != HAL_OK)
  {
    Error_Handler();
  }
}

static void MX_GPIO_Init(void)
{

  /* GPIO Ports Clock Enable */
  __HAL_RCC_GPIOA_CLK_ENABLE();

}

/* USER CODE BEGIN 4 */
void ledInit()
{
	LED_C_init.Pin = GPIO_PIN_6 | GPIO_PIN_7 | GPIO_PIN_8 | GPIO_PIN_9;
	LED_C_init.Alternate = 0;
	LED_C_init.Mode = GPIO_MODE_OUTPUT_PP;
	LED_C_init.Speed = GPIO_SPEED_FREQ_LOW;
	LED_C_init.Pull = GPIO_NOPULL;

	LED_D_init.Pin = GPIO_PIN_3;
	LED_D_init.Alternate = 0;
	LED_D_init.Mode = GPIO_MODE_OUTPUT_PP;
	LED_D_init.Speed = GPIO_SPEED_FREQ_LOW;
	LED_D_init.Pull = GPIO_NOPULL;

	LED_E_init.Pin = GPIO_PIN_4 | GPIO_PIN_5 | GPIO_PIN_6;
	LED_E_init.Alternate = 0;
	LED_E_init.Mode = GPIO_MODE_OUTPUT_PP;
	LED_E_init.Speed = GPIO_SPEED_FREQ_LOW;
	LED_E_init.Pull = GPIO_NOPULL;

	HAL_GPIO_Init(GPIOC, &LED_C_init);
	HAL_GPIO_Init(GPIOD, &LED_D_init);
	HAL_GPIO_Init(GPIOE, &LED_E_init);

}

void lightLED(int numberOfLED)
{
	if(numberOfLED >= 0 && numberOfLED <= 3)
		HAL_GPIO_WritePin(GPIOC, values_for_LEDS_C[numberOfLED], GPIO_PIN_SET);
	else if(numberOfLED == 4)
		HAL_GPIO_WritePin(GPIOE, values_for_LEDS_E[0], GPIO_PIN_SET);
	else if(numberOfLED == 5)
		HAL_GPIO_WritePin(GPIOD, GPIO_PIN_3, GPIO_PIN_SET);
	else
		HAL_GPIO_WritePin(GPIOE, values_for_LEDS_E[numberOfLED-5], GPIO_PIN_SET);
}

void lightAllLEDS()
{
	int i;
	for(i = 0; i < 8; i++)
	{
		lightLED(i);
		HAL_Delay(200);
	}
}

void resetLED(int numberOfLED)
{
	if(numberOfLED >= 0 && numberOfLED <= 3)
		HAL_GPIO_WritePin(GPIOC, values_for_LEDS_C[numberOfLED], GPIO_PIN_RESET);
	else if(numberOfLED == 4)
		HAL_GPIO_WritePin(GPIOE, values_for_LEDS_E[0], GPIO_PIN_RESET);
	else if(numberOfLED == 5)
		HAL_GPIO_WritePin(GPIOD, GPIO_PIN_3, GPIO_PIN_RESET);
	else
		HAL_GPIO_WritePin(GPIOE, values_for_LEDS_E[numberOfLED-5], GPIO_PIN_RESET);

}

void resetAllLEDS()
{
	int i;
	for(i = 0; i < 8; i++)
	{
		resetLED(i);
		HAL_Delay(200);
	}
}
/* USER CODE END 4 */

void Error_Handler(void)
{
  __disable_irq();
  while (1)
  {
  }
}
